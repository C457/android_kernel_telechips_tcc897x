## arch/arm/configs/daudiokk_lgit_4G_9x28_dual_modem_defconfig
```kconfig
CONFIG_USB_ACM=y
CONFIG_USB_SERIAL=y
CONFIG_USB_SERIAL_GENERIC=y
CONFIG_USB_SERIAL_LGIT_9x28_MODEM=y
CONFIG_USB_LGIT_RMNET_MULTI=y
```

## arch/arm/configs/daudiokk_lgit_4G_9x28_modem_defconfig
```kconfig
CONFIG_USB_LGIT_GOBIUSBNET=y
CONFIG_USB_ACM=y
CONFIG_USB_SERIAL=y
CONFIG_USB_SERIAL_GENERIC=y
CONFIG_USB_SERIAL_LGIT_9x28_MODEM=y
```

## arch/arm/mach-tcc897x/Kconfig
```kconfig
if ARCH_TCC897X

comment "Machine Features"

config ARCH_TCC_MAP_CONVERTER
	bool "TCC VIDEO MAP DECOMPRESSOR"
	default n

config TCC_STB_PMAP_SUPPORT
	bool "Support PMAP Table for STB solution"
	default n
	help
	  Use PMAP Table for STB solution (pmap_stb.c) instead of normal PMAP Table (pmap.c)

choice
	prompt "Select PMAP Table"
	depends on TCC_STB_PMAP_SUPPORT
	default PMAP_TCC8970_STB

config PMAP_TCC8970_STB
  bool "TCC8970 STB"
config PMAP_TCC8975_STICK
	bool "TCC8975 STICK"
endchoice

config SUPPORT_TCC_NSK
    bool "Support PMAP Reserved Memory for NSK Solution"
    default n
    help 
        used for NSK Solution for dedicated memory region

endif

config DAUDIO
	bool "D-Audio Board"
	depends on ARCH_TCC897X
	help
	  Support for the TCC897X D-Audio board. Say Y here if you
	  have such a device.

config DAUDIO_KK
	bool "D-Audio1.1 (KitKat) Board"
	depends on DAUDIO
	help
		Support for D-Audio1.1 board. Say Y here if you have such a device.
config IF_VIOC
	bool "D-Audio if voic"

config DAUDIO_BSP_VERSION
    int "D-Audio BSP version"
    range 20160512 20170512
    depends on DAUDIO
    default 20160512

config DAUDIO_BSP_CLEINSOFT_VERSION
    int "D-Audio BSP Cleinsoft version"
    range 2016051201 2017051299
    depends on DAUDIO
    default 2016101001

config LK_DEBUG_LOG_BUF
	bool "CONFIG_LK_DEBUG_LOG_BUF"
```

## drivers/cdrom/Kconfig
```kconfig
menu "CDROM Device Support"

config BLK_CDROM_SUPPORT
	tristate "Unifom Cdrom Driver Support"

endmenu
```

## drivers/char/daudio/Kconfig
```kconfig
config DAUDIO_INFO
	boolean "D-Audio Info"
	default y
	depends on DAUDIO
	help
	  D-Audio Info.

config DAUDIO_INFO_ATAGS
	boolean "D-Audio Info using ATAGS"
	default n
	depends on DAUDIO_INFO && ATAGS && !DAUDIO_INFO_CMDLINE
	help
		D-Audio Info using ATAGS.

config DAUDIO_INFO_CMDLINE
	boolean "D-Audio Info using Kernel Command Line"
	default y
	depends on DAUDIO_INFO
	help
		D-Audio Info using Kernel Command Line.
```

## drivers/char/rear_cam/Kconfig
```kconfig
menu "Rear-camera"


config TCC_EARLY_CAMERA_CPU

   bool "TCC Early/Rear-camera function with cpu interface"
   default n
   depends on PLATFORM_AVN && (ARCH_TCC896X ||  ARCH_TCC897X)
   help
     TCC Automotive Early/Rear-camera with cpu interface.
 

config TCC_REAR_CAMERA_DRV
   bool "TCC Rear camera control driver"
   default n
   depends on PLATFORM_AVN && (TCC_EARLY_CAMERA_CPU && (ARCH_TCC896X ||  ARCH_TCC897X))
   help
     TCC Automotive Rear camera driver.
	 TCC893X : Rear gear event set & get
	 TCC892X : Rear-cam of kernel driver and get reat gear event.
endmenu
```

## drivers/char/tcc_early_view_control/Kconfig
```kconfig
config TCC_EARLY_VIEW_CM_CONTROL
	tristate "TCC Early-View CM Control"
	default y
	depends on (ARCH_TCC897X || ARCH_TCC570X || ARCH_TCC802X)
	depends on PLATFORM_AVN
	help
		Support to TCC89xx Early-View Solution.
```

## drivers/char/vpu/Kconfig
```kconfig
#
# VPU device configuration
#

menuconfig TCC_VPU_DRV
	tristate "VPU-Video Process Unit"

if TCC_VPU_DRV

config SUPPORT_TCC_HEVC
    bool "support HEVC Decoder"
    depends on (ARCH_TCC896X || ARCH_TCC897X || ARCH_TCC898X)
    default y
	help
	Enable HEVC codec.

if SUPPORT_TCC_HEVC
config SUPPORT_TCC_HEVC_4K
    default n
	depends on (SUPPORT_TCC_HEVC && (ARCH_TCC896X || ARCH_TCC898X))
	bool "support 4K resolution"
	help
		4K Resolution for HEVC
endif

config SUPPORT_TCC_VP9
    bool "support VP9 Codec"
    default y
    depends on (ARCH_TCC898X)
	help
	Enable VP9 codec.

if SUPPORT_TCC_VP9
config SUPPORT_TCC_VP9_4K
    default n
    depends on (SUPPORT_TCC_VP9 && ARCH_TCC898X)
    bool "support 4K resolution"
    help
        4K Resolution for VP9
endif

config SUPPORT_TCC_JPU
    bool "support JPU Codec"
    default y
	help
	Enable JPU codec.

choice
	prompt "Instance count of Decoder"
	default DEC_MAX_CNT_1
	help
	  max instance count for decoder

config VDEC_CNT_1
	bool "max 1"
	select VDEC_MAX_CNT_1

config VDEC_CNT_2
	bool "max 2"
	select VDEC_MAX_CNT_2

config VDEC_CNT_3
	bool "max 3"
	select VDEC_MAX_CNT_3

config VDEC_CNT_4
	bool "max 4"
	select VDEC_MAX_CNT_4

endchoice

choice
	prompt "Instance count of Encoder"
	depends on (SUPPORT_TCC_JPU || ARCH_TCC893X || ARCH_TCC896X)
	default ENC_MAX_CNT_1
	help
	  max instance count for encoder

config VENC_CNT_1
	bool "max 1"
	select VENC_MAX_CNT_1

config VENC_CNT_2
	bool "max 2"
	select VENC_MAX_CNT_2

config VENC_CNT_3
	bool "max 3"
	select VENC_MAX_CNT_3

config VENC_CNT_4
	bool "max 4"
	select VENC_MAX_CNT_4

config ENC_NO_SUPPORT
    depends on (SUPPORT_TCC_JPU || ARCH_TCC893X || ARCH_TCC896X)
    bool "not support"
    select ENC_NOT_SUPPORT

endchoice

config VENC_BUFFER_SIZE
    int "Encoder's buffer size (1 => 1MB, ex> 15MB(720p)/30MB(1080p))"
    depends on (SUPPORT_TCC_JPU || ARCH_TCC893X || ARCH_TCC896X)
	default 0
	help
	   Select buffer size of Encoder.

config VPU_ALLOC_MEM_IN_SPECIFIC_SEQUENCE
	bool "alloc memory in specific sequence"
	help
	  To alloc memory in regular sequence only specific case like black-box in linux platform.

config VPU_TIME_MEASUREMENT
    bool "processing time masurement"
	help
		Enable to measure the time of decoding/encoding.

config TEST_VPU_DRAM_INTLV
	bool "dram interleaving test"
	depends on ARCH_TCC896X
	help
		Enable to test DRAM Interleaving
endif # TCC_VPU_DRV
```

## drivers/gpu/arm/mali400/Kconfig
```kconfig
source "drivers/gpu/arm/mali400/mali/Kconfig"
source "drivers/gpu/arm/mali400/ump/Kconfig"
```

## drivers/gpu/drm/tcc/Kconfig
```kconfig
config DRM_TCC
	tristate "DRM Support for Telechips SoC Series"
	depends on DRM && ARCH_TCC
	select DRM_KMS_HELPER
	select DRM_KMS_FB_HELPER
	select FB_CFB_FILLRECT
	select FB_CFB_COPYAREA
	select FB_CFB_IMAGEBLIT
	select VT_HW_CONSOLE_BINDING if FRAMEBUFFER_CONSOLE
	select VIDEOMODE_HELPERS
	help
	  Choose this option if you have a Telechips SoC TCC chipset.
	  If M is selected the module will be called tccdrm.

config DRM_TCC_IOMMU
	bool "TCC DRM IOMMU Support"
	depends on DRM_TCC && TCC_IOMMU && ARM_DMA_USE_IOMMU
	help
	  Telechips SoCs are not support IOMMU.
	  Choose this option if you want to use IOMMU feature for DRM.

config DRM_TCC_DMABUF
	bool "TCC DRM DMABUF"
	depends on DRM_TCC
	help
	  Choose this option if you want to use DMABUF feature for DRM.

config DRM_TCC_LCD
	bool "TCC DRM LCD"
	depends on OF && DRM_TCC
	#depends on !FB_TCC
	select FB_MODE_HELPERS
	help
	  Choose this option if you want to use LCD for DRM.

#
# Debugging messages
#
menuconfig DRM_DRV_DEBUG
	bool "DRM Debugging messages (DEVELOPMENT)"
	depends on DRM_TCC
	help
	  Choose this option if you want to use debugging messages (DEVELOPMENT).
	  You can choice various debugging messages.
	  Kernel debugging level is 'KERN_DEBUG <7>'. (use "dmesg -n 8")

if DRM_DRV_DEBUG

config DRM_UT_CORE
	bool "DRM core messages"
	help
	  Choose this option if you want to enable DRM core debugging messages.
	  Kernel debugging level is 'KERN_DEBUG <7>'. (use "dmesg -n 8")

config DRM_UT_DRIVER
	bool "DRM driver messages"
	help
	  Choose this option if you want to enable DRM driver debugging messages.
	  Kernel debugging level is 'KERN_DEBUG <7>'. (use "dmesg -n 8")

config DRM_UT_KMS
	bool "DRM KMS messages"
	help
	  Choose this option if you want to enable DRM KMS debugging messages.
	  Kernel debugging level is 'KERN_DEBUG <7>'. (use "dmesg -n 8")

config DRM_UT_PRIME
	bool "DRM PRIME messages"
	help
	  Choose this option if you want to enable DRM PRIME debugging messages.
	  Kernel debugging level is 'KERN_DEBUG <7>'. (use "dmesg -n 8")

config DRM_TCC_DEBUG
	bool "DRM TCC messages"
	help
	  Choose this option if you want to enable specific TCC debugging messages.
	  Kernel debugging level is 'KERN_DEBUG <7>'. (use "dmesg -n 8")

endif
```

## drivers/gpu/vivante/gc/Kconfig
```kconfig
menuconfig GC_GPU
	tristate "Vivante-GC support"
	default y
	depends on ((ARCH_TCC897X || ARCH_TCC898X) && !ANDROID)
	---help---
	  Device driver for the VIVANTE GC GPU

if GC_GPU
config SUPPORT_2D_COMPRESSION
    default y
	depends on (ARCH_TCC898X)
	bool "Support 2D Compression"
	help
		2D FBC for DEC100

config ADDITIONAL_TS_BUFFER_LINES
    int "Additional lines in framebuffer (4096x2160 => 16, 3840x2160 => 12)"
	    depends on (SUPPORT_2D_COMPRESSION)
	    default 16
	    help
	       Select additional lines for ts-buffer in framebuffer.
endif
```

## drivers/input/touchscreen/atmel/Kconfig
```kconfig
#
# Touchscreen driver configuration for TOUCHSCREEN_ATMEL_MXT_336S_AT
#

if INPUT_TOUCHSCREEN

config TOUCHSCREEN_ATMEL_MXT_336S_AT
	tristate "Atmel mXT I2C Touchscreen (MXT_336S_AT)"
	depends on I2C
	help
	  Say Y here if you have Atmel mXT MXT_336S_AT I2C touchscreen
		connected to your system.

endif
```

## drivers/media/platform/tcccam/Kconfig
```kconfig
#
#
#
#
config VIDEO_TCCXXX_V4L_DEVICE
	tristate "Telechips V4L Platform device support"
	select VIDEOBUF_GEN
	select VIDEOBUF_DMA_SG
	select VIDEOBUF_VMALLOC
	depends on VIDEO_DEV
	help
	  V4L2 Platform device support for TCCXXX.

#Pmap
config VIDEO_V4L2_VIDEO_X_MEMORY_ALLOC
	tristate "Video V4L2 videox pmap support"
	depends on VIDEO_TCCXXX_V4L_DEVICE
	help
	   Allocate pmap memory for tcccam

config VIDEO_V4L2_VIDEO_0
	tristate "Video V4L2 video0 pmap enable"
	depends on VIDEO_V4L2_VIDEO_X_MEMORY_ALLOC
	help
	   enable video0 pmap area enable

config VIDEO_V4L2_VIDEO_1
	tristate "Video V4L2 video1 pmap enable"
	depends on VIDEO_V4L2_VIDEO_X_MEMORY_ALLOC
	help
	   enable video1 pmap area enable

config TCC_REAR_CAMERA_DRV
	tristate "Telechips AVN Rear-Camera(Linux platform) support"
	depends on PLATFORM_AVN
	depends on VIDEO_DEV
	depends on LINUX_ANDROID
	help
	   tcc camera direct display solution
	   
config VIDEO_V4L_SENSOR
    tristate "Video sensor support"
    depends on VIDEO_TCCXXX_V4L_DEVICE
    help
       video sensor support

#Dual Camera Config

config VIDEO_DUAL_CAMERA_SUPPORT
	tristate "Enable Telechips Dual-Camera"
	depends on VIDEO_V4L_SENSOR
	help
	   tcc dual-camera suport

#Back Camera

config VIDEO_DUAL_BACK_CAMERA_SUPPORT
	tristate "Select Telechips Back-Camera"
	depends on VIDEO_DUAL_CAMERA_SUPPORT
	help
	   tcc dual-camera suport

config VIDEO_CAMERA_SENSOR_MT9P111
	tristate "MT9P111 5MP-sensor support"
    depends on VIDEO_DUAL_BACK_CAMERA_SUPPORT
	help
	   camera sensor support for 5MP		

config VIDEO_CAMERA_SENSOR_MT9T111
        tristate "MT9T111 3MP-sensor support"
        depends on VIDEO_DUAL_BACK_CAMERA_SUPPORT
        help
           camera sensor support for 3MP
           
config VIDEO_CAMERA_SENSOR_S5K5CAGA
        tristate "S5K5CAGA 3MP-sensor support"
        depends on VIDEO_DUAL_BACK_CAMERA_SUPPORT
        help
           camera sensor support for 3MP

config VIDEO_CAMERA_SENSOR_MT9T113
        tristate "MT9T113 3MP-sensor support"
        depends on VIDEO_DUAL_BACK_CAMERA_SUPPORT        
        help
           camera sensor support for 3MP           
 
config VIDEO_CAMERA_SENSOR_MT9D112
        tristate "MT9D112 2MP-sensor support"
        depends on VIDEO_DUAL_BACK_CAMERA_SUPPORT
        help
           camera sensor support for 2MP
	

#Front Camera
	   
config VIDEO_DUAL_FRONT_CAMERA_SUPPORT
	tristate "Select Telechips Front-Camera"
	depends on VIDEO_DUAL_CAMERA_SUPPORT
	help
	   tcc dual-camera suport

config VIDEO_CAMERA_SENSOR_MT9M113
		 tristate "MT9M113 1.3MP-sensor support"
		 depends on VIDEO_DUAL_FRONT_CAMERA_SUPPORT
		 help
		    camera sensor support for 1.3MP

config VIDEO_CAMERA_SENSOR_SR130PC10
		 tristate "SR130PC10 1.3MP-sensor support"
		 depends on VIDEO_DUAL_FRONT_CAMERA_SUPPORT
		 help
		    camera sensor support for 1.3MP
    
config VIDEO_CAMERA_SENSOR_OV7690
        tristate "OV7690 VGA-sensor support"
        depends on VIDEO_DUAL_FRONT_CAMERA_SUPPORT
        help
           camera sensor support for VGA

config VIDEO_CAMERA_SENSOR_SIV100B
        tristate "SIV100B VGA-sensor support"
        depends on VIDEO_DUAL_FRONT_CAMERA_SUPPORT
        help
           camera sensor support for VGA


#Single Camera Config

config VIDEO_SINGLE_CAMERA_SUPPORT
	tristate "Enable Telechips Single-Camera"
	depends on VIDEO_V4L_SENSOR
	help
	   tcc single-camera suport

config VIDEO_CAMERA_SENSOR_MT9P111
	tristate "MT9P111 5MP-sensor support"
    depends on VIDEO_SINGLE_CAMERA_SUPPORT
	help
	   camera sensor support for 5MP		

config VIDEO_CAMERA_SENSOR_MT9T111
        tristate "MT9T111 3MP-sensor support"
        depends on VIDEO_SINGLE_CAMERA_SUPPORT
        help
           camera sensor support for 3MP
           
config VIDEO_CAMERA_SENSOR_S5K5CAGA
        tristate "S5K5CAGA 3MP-sensor support"
		depends on VIDEO_SINGLE_CAMERA_SUPPORT        
        help
           camera sensor support for 3MP

config VIDEO_CAMERA_SENSOR_MT9T113
        tristate "MT9T113 3MP-sensor support"
        depends on VIDEO_SINGLE_CAMERA_SUPPORT
        help
           camera sensor support for 3MP           
 
config VIDEO_CAMERA_SENSOR_MT9D112
        tristate "MT9D112 2MP-sensor support"
        depends on VIDEO_SINGLE_CAMERA_SUPPORT
        help
           camera sensor support for 2MP

config VIDEO_CAMERA_SENSOR_MT9M113
		 tristate "MT9M113 1.3MP-sensor support"
		 depends on VIDEO_SINGLE_CAMERA_SUPPORT
		 help
		    camera sensor support for 1.3MP

config VIDEO_CAMERA_SENSOR_SR130PC10
		 tristate "SR130PC10 1.3MP-sensor support"
		 depends on VIDEO_SINGLE_CAMERA_SUPPORT
		 help
		    camera sensor support for 1.3MP
    
config VIDEO_CAMERA_SENSOR_OV7690
        tristate "OV7690 VGA-sensor support"
        depends on VIDEO_SINGLE_CAMERA_SUPPORT
        help
           camera sensor support for VGA

config VIDEO_CAMERA_SENSOR_SIV100B
        tristate "SIV100B VGA-sensor support"
        depends on VIDEO_SINGLE_CAMERA_SUPPORT
        help
           camera sensor support for VGA           

source drivers/media/platform/tcccam/atv/Kconfig
```

## drivers/media/platform/tcccam/atv/Kconfig
```kconfig
config VIDEO_TCCXX_ATV
	tristate "Enable Telechips ATV Receiver"
	depends on VIDEO_V4L_SENSOR
	help
	  V4L2 Analog TV driver support for TCCXXX.
	
config VIDEO_ATV_SENSOR
	tristate "ATV sensor support"
	depends on VIDEO_TCCXX_ATV
	help
	   atv sensor support

config VIDEO_ATV_SENSOR_TVP5150
	tristate "TVP5150 ATV-sensor support"
	depends on VIDEO_ATV_SENSOR
	help
		atv sensor support for TVP5150

config VIDEO_ATV_SENSOR_ADV7182
	tristate "ADV7182 ATV-sensor support"
	depends on VIDEO_ATV_SENSOR
	help
		atv sensor support for ADV7182

config VIDEO_ATV_SENSOR_DAUDIO
        tristate "D-Audio TV Decoder Support"
        depends on VIDEO_ATV_SENSOR
        help
	   TV decoder support for D-Audio

config LVDS_CAMERA
        tristate "LVDS Camera Support"
        help
	   LVDS Camera Support

config LVDS_CAMERA_BT601
        tristate "LVDS BT601 Camera Support"
        depends on LVDS_CAMERA
        help
	   LVDS BT601 Camera Support




































 
```

## drivers/media/platform/tcchdin_linux/Kconfig
```kconfig
config VIDEO_TCCXX_HDMI_IN
	tristate "Telechips HDMI Receiver device support"
	select VIDEOBUF_GEN
	select VIDEOBUF_DMA_SG
	select VIDEOBUF_VMALLOC
	depends on VIDEO_DEV
	help
	  V4L2 HDMI IN Receiver driver support for TCCXXX.
	
config VIDEO_HDMI_IN_SENSOR
	tristate "HDMI/MHL Module support"
	depends on VIDEO_TCCXX_HDMI_IN
	help
	   HDMI IN Receiver support

source drivers/media/platform/tcchdin/module/Kconfig










































 
```
